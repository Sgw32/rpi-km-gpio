/dts-v1/;
/plugin/;
/ {
	compatible = "brcm,bcm2835";
	fragment@0 {
		target-path = "/";
		__overlay__ {
			m_gpdev {
				compatible = "brightlight,gpdev";
				status = "okay";
				label = "Test";
				my_value = <12>;
				green-led-gpio = <&gpio 21 0>; 
			};
		};
	};
};